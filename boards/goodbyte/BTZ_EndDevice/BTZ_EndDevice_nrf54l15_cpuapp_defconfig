## boards/goodbyte/BTZ_EndDevice/Kconfig.BTZ_EndDevice
```kconfig
# Copyright (c) 2026 Goodbyte
# SPDX-License-Identifier: Apache-2.0

config BOARD_BTZ_ENDDEVICE
	select SOC_NRF54L15_CPUAPP if BOARD_BTZ_ENDDEVICE_NRF54L15_CPUAPP
```

## boards/goodbyte/BTZ_EndDevice/Kconfig.defconfig
```kconfig
# Copyright (c) 2024 Nordic Semiconductor ASA
# SPDX-License-Identifier: Apache-2.0

config HW_STACK_PROTECTION
	default ARCH_HAS_STACK_PROTECTION
```

## boards/goodbyte/BTZ_EndDevice/board.yml
```yaml
board:
  name: BTZ_EndDevice
  full_name: BTZ End Device
  vendor: goodbyte
  socs:
    - name: nrf54l15
```
